// SPDX-License-Identifier: (GPL-2.0 OR MIT)

/dts-v1/;

#include "mt7981b-cudy-m3000.dtsi"

/ {
	model = "Cudy M3000 v1/v2";
	compatible = "cudy,m3000-v1", "mediatek,mt7981";
};

&mdio_bus {
	/*
	 * HW reset is handled in U-Boot. U-Boot also applies
	 * a workaround for a MDIO bus address collision, so Linux
	 * may not hard-reset the PHY anyway.
	 */

	wan_phy: ethernet-phy@1 {
		compatible = "ethernet-phy-ieee802.3-c45";
		reg = <1>;
		interrupts = <38 IRQ_TYPE_LEVEL_LOW>;
		interrupt-parent = <&pio>;
	};
};
